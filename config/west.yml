## config/west.yml
```yaml
# config/west.yml
manifest:
  defaults:
    remote: zmk
  remotes:
    - name: zmk
      url-base: https://github.com/zmkfirmware
    - name: zephyrproject
      url-base: https://github.com/zephyrproject-rtos

  projects:
    # 1) ZMK firmware (imports its own sub‐manifest app/west.yml)
    - name: zmk
      remote: zmk
      repo-path: app
      revision: main
      import: app/west.yml

    # 2) Zephyr RTOS
    - name: zephyr
      remote: zephyrproject
      repo-path: modules/zephyr
      revision: v3.5.0

    # 3) Nordic HAL modules
    - name: hal_nordic
      remote: zephyrproject
      repo-path: modules/hal/nordic
      revision: main
    - name: nrfx
      remote: zephyrproject
      repo-path: modules/hal/nordic/nrfx
      revision: main
    - name: nrfxlib
      remote: zephyrproject
      repo-path: modules/hal/nordic/nrfxlib
      revision: main
```

## west.yml
```yaml
# west.yml — pune-l în rădăcina repo-ului (nu în config/)
manifest:
  version: 0.11

  defaults:
    # Proiectele fără remote specificat vor folosi "zmk" ca remote implicit
    remote: zmk

  remotes:
    - name: zmk
      url-base: https://github.com/zmkfirmware
    - name: zephyrproject
      url-base: https://github.com/zephyrproject-rtos

  projects:
    # 1) ZMK firmware
    - name: zmk
      remote: zmk
      repo-path: app
      revision: main
      import: app/west.yml    # importă sub-manifestul ZMK însuși

    # 2) Zephyr RTOS
    - name: zephyr
      remote: zephyrproject
      repo-path: modules/zephyr
      revision: v3.5.0

    # 3) HAL Nordic (în subfolder Zephyr)
    - name: hal_nordic
      remote: zephyrproject
      repo-path: modules/hal/nordic
      revision: main

    # 4) nrfx
    - name: nrfx
      remote: zephyrproject
      repo-path: modules/hal/nordic/nrfx
      revision: main

    # 5) nrfxlib
    - name: nrfxlib
      remote: zephyrproject
      repo-path: modules/hal/nordic/nrfxlib
      revision: main
```
